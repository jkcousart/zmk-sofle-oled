## config/west.yml
```yaml
manifest:
  remotes:
    - name: zmkfirmware
      url-base: https://github.com/zmkfirmware
    - name: jkcousart
      url-base: https://github.com/jkcousart
    - name: eyelash
      url-base: https://github.com/a741725193
    - name: cormoran
      url-base: https://github.com/cormoran
  projects:
    - name: zmk
      remote: cormoran
      revision: v0.3-branch+dya
      import: app/west.yml
    - name: zmk-behavior-runtime-sensor-rotate
      remote: cormoran
      revision: main
    - name: zmk-module-ble-management
      remote: cormoran
      revision: zmk-v0.3.0.0
    - name: zmk-module-battery-history
      remote: cormoran
      revision: main
    - name: zmk-module-settings-rpc
      remote: cormoran
      revision: main
    - name: zmk-module-runtime-input-processor
      remote: cormoran
      revision: zmk-v0.3.0.0
    - name: zmk-nice-oled
      remote: jkcousart
      revision: main
    - name: zmk-board-eyelash
      remote: eyelash
      revision: main
  self:
    path: config
```
